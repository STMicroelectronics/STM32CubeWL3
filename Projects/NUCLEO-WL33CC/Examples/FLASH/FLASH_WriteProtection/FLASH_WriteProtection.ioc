# file: FLASH_WriteProtection.ioc
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Mcu.Family=STM32WL3
Mcu.Name=STM32WL33CCVx
Mcu.Package=VFQFPN48
OSCIN.Mode=HSE-External-Oscillator
OSCIN.Signal=RCC_OSC_IN
OSCOUT.Mode=HSE-External-Oscillator
OSCOUT.Signal=RCC_OSC_OUT
ProjectManager.HeapSize=0x000
ProjectManager.StackSize=0xC00
ProjectManager.TargetToolchain=EWARM V9.30
RCC.HSE_VALUE=48000000
RCC.HSI_VALUE=64000000
RCC.LSE_VALUE=32768
RCC.RC64MPLLSource=RCC_LSCOSOURCE_PLL64
VP_PWR_VS_SECSignals.Mode=Security/Privilege
board=custom

// file: Src/main.c
/* USER CODE BEGIN Header */
/**
  ******************************************************************************
  * @file    FLASH/FLASH_WriteProtection/Src/main.c
  * @author  MCD Application Team
  * @brief   This example provides a description of how to set write protection on
  *          STM32WL3x FLASH.
  ******************************************************************************
  * @attention
  *
  * Copyright (c) 2024 STMicroelectronics.
  * All rights reserved.
  *
  * This software is licensed under terms that can be found in the LICENSE file
  * in the root directory of this software component.
  * If no LICENSE file comes with this software, it is provided AS-IS.
  *
  ******************************************************************************
  */
/* USER CODE END Header */
#include "main.h"

/* USER CODE BEGIN PTD */
typedef enum {FAILED = 0, PASSED = !FAILED} TestStatus;
/* USER CODE END PTD */

/* USER CODE BEGIN PD */

#define FLASH_USER_START_ADDR   (FLASH_END_ADDR - FLASH_PAGE_SIZE + 1)
#define FLASH_USER_END_ADDR     (FLASH_END_ADDR + 1)

#define DATA_32                     ((uint32_t)0x12345678)

/* Uncomment this line to program the Flash pages */
/* #define FLASH_PAGE_PROGRAM */

/* Uncomment this line to Enable Write Protection */
/* #define WRITE_PROTECTION_ENABLE */

/* Uncomment this line to Disable Write Protection */
#define WRITE_PROTECTION_DISABLE

/* USER CODE END PD */

/* USER CODE BEGIN PV */
uint32_t FirstPage = 0, NbOfPages = 0;
uint32_t Address = 0, PageError = 0;
__IO uint32_t MemoryProgramStatus = 0;

/*Variable used for Erase procedure*/
#ifdef FLASH_PAGE_PROGRAM
static FLASH_EraseInitTypeDef EraseInitStruct;
#endif

/* USER CODE END PV */

void SystemClock_Config(void);
void PeriphCommonClock_Config(void);
static void MX_GPIO_Init(void);
/* USER CODE BEGIN PFP */
static uint32_t GetPage(uint32_t Address);

/* USER CODE END PFP */

int main(void)
{

  /* USER CODE BEGIN 1 */
  /* STM32WL3x HAL library initialization:
       - Systick timer is configured by default as source of time base, but user
             can eventually implement his proper time base source (a general purpose
             timer for example or other time source), keeping in mind that Time base
             duration should be kept 1ms since PPP_TIMEOUT_VALUEs are defined and
             handled in milliseconds basis.
       - Set NVIC Group Priority to 4
       - Low Level Initialization
     */

  /* USER CODE END 1 */

  /* MCU Configuration--------------------------------------------------------*/

  /* Reset of all peripherals, Initializes the Flash interface and the Systick. */
  HAL_Init();

  /* Configure the system clock */
  SystemClock_Config();

  /* Configure the peripherals common clocks */
  PeriphCommonClock_Config();

  /* Initialize all configured peripherals */
  MX_GPIO_Init();
  /* USER CODE BEGIN 2 */
  /* Initialize LD1, LD2 and LD3 */
  BSP_LED_Init(LD1);
  BSP_LED_Init(LD2);
  BSP_LED_Init(LD3);

   /* Get the 1st page */
  FirstPage = GetPage(FLASH_USER_START_ADDR);

  /* Get the number of pages from 1st page */
  NbOfPages = GetPage(FLASH_USER_END_ADDR) - FirstPage;

#ifdef WRITE_PROTECTION_DISABLE

  /* Disable the page write protection for group 15 containing Flash pages 120 to 127 */
  FLASH_PageProtectionTypeDef pageProtectionStruct = {0};

  uint32_t seg0_offset = (FirstPage << 0x8) & 0xFF00;
  uint32_t seg0_size  = NbOfPages & 0x00FF;
  pageProtectionStruct.pageProt_0 =  seg0_offset | seg0_size;
  pageProtectionStruct.state = DISABLE;

  /* It allows protecting from write and page erase. */

  HAL_FLASHEx_PageProtection(&pageProtectionStruct);

#elif defined WRITE_PROTECTION_ENABLE

    /* Enable the page write protection for group 15 containing Flash pages 120 to 127 */
  FLASH_PageProtectionTypeDef pageProtectionStruct = {0};

  uint32_t seg0_offset = (FirstPage << 0x8) & 0xFF00;
  uint32_t seg0_size  = NbOfPages & 0x00FF;
  pageProtectionStruct.pageProt_0 =  seg0_offset | seg0_size;
  pageProtectionStruct.state = ENABLE;

  /* It allows protecting from write and page erase. */

  HAL_FLASHEx_PageProtection(&pageProtectionStruct);

#endif /* WRITE_PROTECTION_DISABLE */

#ifdef FLASH_PAGE_PROGRAM

  /* The desired pages are not write protected */
  /* Fill EraseInit structure************************************************/
  EraseInitStruct.TypeErase   = FLASH_TYPEERASE_PAGES;
  EraseInitStruct.Page        = FirstPage;
  EraseInitStruct.NbPages     = NbOfPages;

  if (HAL_FLASHEx_Erase(&EraseInitStruct, &PageError) != HAL_OK)
  {
    /*
      Error occurred while page erase.
      User can add here some code to deal with this error.
      PageError will contain the faulty page and then to know the code error on this page,
      user can call function 'HAL_FLASH_GetError()'
    */
    while (1)
    {
      Error_Handler();
    }
  }

#endif /* FLASH_PAGE_PROGRAM */

  /* Program the user Flash area word by word
  (area defined by FLASH_USER_START_ADDR and FLASH_USER_END_ADDR) ***********/

  Address = FLASH_USER_START_ADDR;

  while (Address < FLASH_USER_END_ADDR)
  {
    if (HAL_FLASH_Program(FLASH_TYPEPROGRAM_WORD,Address, DATA_32) == HAL_OK)
    {
      Address = Address + 4;
      MemoryProgramStatus++;
    }
    if (MemoryProgramStatus != 0)
    {
      /* No error detected. Switch on LED1*/
      BSP_LED_On(LD1);
    }
    else
    {
      /* Error occurred while writing data in Flash memory.
        User can add here some code to deal with this error */

      BSP_LED_On(LD2);
    }
  /* USER CODE END 2 */

  /* Infinite loop */
    while (1)
    {

    }
  }
}

void SystemClock_Config(void)
{
  RCC_OscInitTypeDef RCC_OscInitStruct = {0};
  RCC_ClkInitTypeDef RCC_ClkInitStruct = {0};

  /** Initializes the RCC Oscillators according to the specified parameters
  * in the RCC_OscInitTypeDef structure.
  */
  RCC_OscInitStruct.OscillatorType = RCC_OSCILLATORTYPE_HSE;
  RCC_OscInitStruct.HSEState = RCC_HSE_ON;
  if (HAL_RCC_OscConfig(&RCC_OscInitStruct) != HAL_OK)
  {
    Error_Handler();
  }

  /** Configure the SYSCLKSource and SYSCLKDivider
  */
  RCC_ClkInitStruct.SYSCLKSource = RCC_SYSCLKSOURCE_RC64MPLL;
  RCC_ClkInitStruct.SYSCLKDivider = RCC_RC64MPLL_DIV1;

  if (HAL_RCC_ClockConfig(&RCC_ClkInitStruct, FLASH_WAIT_STATES_1) != HAL_OK)
  {
    Error_Handler();
  }
}

void PeriphCommonClock_Config(void)
{
  RCC_PeriphCLKInitTypeDef PeriphClkInitStruct = {0};

  /** Initializes the peripherals clock
  */
  PeriphClkInitStruct.PeriphClockSelection = RCC_PERIPHCLK_SMPS;
  PeriphClkInitStruct.SmpsDivSelection = RCC_SMPSCLK_DIV2;
  PeriphClkInitStruct.KRMRateMultiplier = 2;

  if (HAL_RCCEx_PeriphCLKConfig(&PeriphClkInitStruct) != HAL_OK)
  {
    Error_Handler();
  }
}

static void MX_GPIO_Init(void)
{

  /* GPIO Ports Clock Enable */

}

/* USER CODE BEGIN 4 */
/**
  * @brief  Gets the page of a given address
  * @param  Addr: Address of the FLASH Memory
  * @retval The page of a given address
  */
static uint32_t GetPage(uint32_t Addr)
{
  if(!IS_ADDR_ALIGNED_32BITS(Addr)){
    while(1);
  }
  uint32_t page = (Addr - FLASH_START_ADDR) / FLASH_PAGE_SIZE;
  if(!IS_FLASH_PAGE(page)){
    while(1);
  }
  return page;
}
/* USER CODE END 4 */

void Error_Handler(void)
{
  /* USER CODE BEGIN Error_Handler_Debug */
  while(1)
  {
    BSP_LED_On(LD3);
  }
  /* USER CODE END Error_Handler_Debug */
}
